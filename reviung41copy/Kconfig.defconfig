## reviung41copy/Kconfig.defconfig
```kconfig
# Copyright (c) 2020 The ZMK Contributors
# SPDX-License-Identifier: MIT

if SHIELD_REVIUNG41COPY

config ZMK_KEYBOARD_NAME
    default "Reviung41copy"

endif
```

## reviung41copy/Kconfig.shield
```kconfig
# Copyright (c) 2020 The ZMK Contributors
# SPDX-License-Identifier: MIT

config SHIELD_REVIUNG41COPY
    def_bool $(shields_list_contains,reviung41copy)
```
